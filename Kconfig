## Kconfig
```kconfig
mainmenu "bare_app configuration"

menu "Platforms"

config PLATFORM_OGA
	bool "ODROID-GO Advance / Black Edition / Super"
	default y
	select INPUT_EVDEV
	select DISPLAY_FBDEV if !DISPLAY_DRM
	help
	  Picked at run time by the device tree "compatible" of the board.
	  Needs DRM or fbdev for the screen (fbdev is selected if DRM is
	  off), evdev for the buttons and the stick.

config PLATFORM_PC
	bool "PC simulator (platforms pc and pc-mem)"
	select DISPLAY_MEM
	select INPUT_SCRIPT
	help
	  "pc" opens an SDL window if DISPLAY_SDL is on, "pc-mem" always
	  draws into memory (tests, scripted screenshots).

endmenu

menu "Display drivers"

config DISPLAY_DRM
	bool "DRM/KMS with hardware planes"
	default y if PLATFORM_OGA
	help
	  UI on an overlay plane with alpha, video layer on the primary
	  plane, vsync. Raw kernel UAPI, no libdrm needed.

config DISPLAY_FBDEV
	bool "Linux framebuffer (fbdev)"
	default y if PLATFORM_OGA
	help
	  One layer, no video. Used when DRM is missing or busy.

config DISPLAY_MEM
	bool "Display in memory"
	help
	  For tests: draws nothing, can write snapshots.

config DISPLAY_SDL
	bool "SDL2 window (simulator)"
	depends on PLATFORM_PC
	default y
	help
	  Needs SDL2 development files on the build machine
	  (libsdl2-dev).

endmenu

menu "Input drivers"

config INPUT_EVDEV
	bool "evdev: buttons and analog sticks"

config INPUT_HOTPLUG
	bool "Reattach input devices that come and go (uevent)"
	depends on INPUT_EVDEV
	default y

config INPUT_SCRIPT
	bool "Scripted input from stdin"
	help
	  Words on stdin press buttons ("down a wait:500 f6"); only when
	  stdin is not a terminal.

config INPUT_SDL
	bool "SDL keyboard"
	depends on DISPLAY_SDL
	default y

endmenu

menu "System services"

config POWER
	bool "Battery and charger (sysfs power_supply)"
	default y

config POWER_UEVENT
	bool "Re-read the battery on power_supply uevents"
	depends on POWER
	default y
	help
	  Without it the battery is polled every 5 s.

config BACKLIGHT
	bool "Backlight control (sysfs)"
	default y

config AUDIO
	bool "Volume and audio output (ALSA mixer)"
	default y
	help
	  Volume, speaker or headphones (by hand or following the plug),
	  the volume keys. Talks to /dev/snd/controlC* directly: no
	  alsa-lib needed. Simulated on the PC.

config SOUND_FEEDBACK
	bool "Click when the volume changes"
	depends on AUDIO
	default y
	help
	  A short tone at the new level, played on the platform's PCM
	  device (raw ALSA ioctls). The device is released a second after
	  the click, so a game can take it.

config WIFI
	bool "Wi-Fi through wpa_supplicant"
	default y
	help
	  On/off, the networks in range, connecting with a key typed on
	  the on-screen keyboard, forgetting saved networks. Uses the
	  control socket of a running wpa_supplicant (no libwpa_client);
	  the networks are saved in its config file, which needs
	  update_config=1. Getting an address is left to the system's
	  DHCP client. Simulated on the PC.

config SETTINGS_FILE
	bool "Keep settings between runs"
	default y
	help
	  Brightness, volume, audio output, Wi-Fi on/off and language in
	  the platform's settings file (/etc/bare_app.conf on the OGA).

endmenu

menu "User interface"

config VIEW_LVGL
	bool "LVGL view backend"
	default y

config VIEW_HEADLESS
	bool "Headless view backend (logs instead of drawing)"
	default y
	help
	  Also proves the core builds without a GUI toolkit.

if VIEW_LVGL

config SCREEN_INPUT_TEST
	bool "Input test screen"
	default y

config SCREEN_SETTINGS
	bool "Settings screen (brightness, sound, language, Wi-Fi status)"
	default y

config SCREEN_WIFI
	bool "Wi-Fi screens (networks, key entry)"
	depends on WIFI && SCREEN_SETTINGS
	default y
	help
	  Opened from the settings screen.

config SCREEN_LAYERS
	bool "Layers screen (UI over the video layer)"
	default y
	select VIDEO_TESTPATTERN

config UI_FONT_CYRILLIC
	bool "Fonts with Cyrillic (Noto Sans)"
	default y
	help
	  Without it the built-in Montserrat fonts are used: Latin only.

endif

config LANG_RU
	bool "Russian translation"
	depends on UI_FONT_CYRILLIC || !VIEW_LVGL
	default y

config VIDEO_TESTPATTERN
	bool "Test pattern video source"
	help
	  Animated colour bars drawn by a thread into the video layer.

endmenu

menu "Games"

config GAME_DOOM
	bool "Doom (separate program under GPLv2)"
	depends on VIEW_LVGL
	help
	  "Doom" in the main menu. The game is bare_app_doom, built from
	  ports/doom (doomgeneric, GPLv2) and installed next to bare_app,
	  which starts it for each game and talks to it over a socket and
	  shared memory: no GPL code goes into bare_app itself. Needs the
	  ports/doom/doomgeneric submodule. It draws into the video layer,
	  so it needs DRM on the device (pc-mem on the PC). Sound effects
	  go to the platform's ALSA device; no music, no network.

if GAME_DOOM

config GAME_DOOM_WAD
	string "IWAD file"
	default "/usr/share/games/doom/doom1.wad"
	help
	  The game data: doom1.wad (shareware), doom.wad, doom2.wad...
	  BARE_APP_DOOM_WAD overrides it at run time. The SDK package
	  installs the shareware one when asked to.

config GAME_DOOM_DIR
	string "Directory for Doom's settings and saved games"
	default "~/.local/share/bare_app/doom"
	help
	  "~/" means $HOME. Created when the game starts.

endif

config GAME_HOMM3
	bool "Heroes of Might and Magic III (VCMI, separate program)"
	depends on VIEW_LVGL
	help
	  "Heroes III" in the main menu: VCMI's client, built with its
	  bare_app link by the SDK package vcmi (GPLv2, APPS_CONFIG
	  bare-app.HOMM3=y), started for each game like Doom. It draws in
	  software into twice the video layer and sends it scaled down 2:1,
	  or 1:1 around the cursor (L1 switches); the gamepad drives it as
	  a game controller. The game data (Data, Maps, Mp3 of an original
	  installation, optionally the Horn of the Abyss mod) is not
	  included: the SDK's scripts/homm3-install.sh copies it.

if GAME_HOMM3

config GAME_HOMM3_PROGRAM
	string "VCMI client"
	default "/usr/bin/vcmiclient"

config GAME_HOMM3_DATA
	string "Data directory"
	default "/data"
	help
	  VCMI finds the game in <dir>/vcmi (Data, Maps, Mp3, Mods) and
	  keeps its settings in <dir>/config/vcmi and its logs in
	  <dir>/cache/vcmi. BARE_APP_HOMM3_DATA overrides it at run time.
	  /data is the SDK's data partition.

endif

endmenu

menu "Debugging"

config SNAPSHOT
	bool "Screenshots (SIGUSR1, BARE_APP_SHOT)"
	default y
	help
	  Write the composed layers as a PPM image on SIGUSR1, and on exit
	  if BARE_APP_SHOT is set.

config BUILD_TESTS
	bool "Host unit tests and the smoke test"
	depends on PLATFORM_PC && VIEW_HEADLESS
	default y
	help
	  Built only for the host (not when cross-compiling).

endmenu
```
