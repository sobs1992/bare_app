## Kconfig
```kconfig
mainmenu "bare_app configuration"

menu "Platforms"

config PLATFORM_OGA
	bool "ODROID-GO Advance / Black Edition / Super"
	default y
	select INPUT_EVDEV
	select DISPLAY_FBDEV if !DISPLAY_DRM
	help
	  Picked at run time by the device tree "compatible" of the board.
	  Needs DRM or fbdev for the screen (fbdev is selected if DRM is
	  off), evdev for the buttons and the stick.

config PLATFORM_OGU
	bool "ODROID-GO Ultra"
	select INPUT_EVDEV
	select DISPLAY_FBDEV if !DISPLAY_DRM
	help
	  Picked at run time by the device tree "compatible" of the board,
	  so one build can carry it together with the OGA. Needs DRM or
	  fbdev for the screen, evdev for the buttons and the two sticks.

config PLATFORM_PC
	bool "PC simulator (platforms pc and pc-mem)"
	select DISPLAY_MEM
	select INPUT_SCRIPT
	help
	  "pc" opens an SDL window if DISPLAY_SDL is on, "pc-mem" always
	  draws into memory (tests, scripted screenshots).

endmenu

menu "Display drivers"

config DISPLAY_DRM
	bool "DRM/KMS with hardware planes"
	default y if PLATFORM_OGA || PLATFORM_OGU
	help
	  UI on an overlay plane with alpha, video layer on the primary
	  plane, vsync. Raw kernel UAPI, no libdrm needed.

config DISPLAY_FBDEV
	bool "Linux framebuffer (fbdev)"
	default y if PLATFORM_OGA || PLATFORM_OGU
	help
	  One layer, no video. Used when DRM is missing or busy.

config DISPLAY_MEM
	bool "Display in memory"
	help
	  For tests: draws nothing, can write snapshots.

config DISPLAY_SDL
	bool "SDL2 window (simulator)"
	depends on PLATFORM_PC
	default y
	help
	  Needs SDL2 development files on the build machine
	  (libsdl2-dev).

endmenu

menu "Input drivers"

config INPUT_EVDEV
	bool "evdev: buttons and analog sticks"

config INPUT_HOTPLUG
	bool "Reattach input devices that come and go (uevent)"
	depends on INPUT_EVDEV
	default y

config INPUT_HID
	bool "USB keyboards and mice"
	depends on INPUT_EVDEV
	default y
	help
	  Any keyboard or mouse, also plugged in later (with INPUT_HOTPLUG).
	  Windows games get the keys and the mouse as they are; elsewhere
	  the arrows, Enter (A), Esc (B), Space (X), Tab (Y), Page Up/Down
	  (L1/R1) and F1..F6 work as the gamepad's buttons.

config INPUT_IMU
	bool "USB motion sensor (gyro aiming)"
	default y
	help
	  The usb_motion_sensor (an IMU behind a Pico, USB serial
	  1209:0001 "USB Motion Sensor"), also plugged in later (with
	  INPUT_HOTPLUG). Its gyro turns the view of a game as a mouse
	  would; each game has it on or off and its sensitivity in its
	  controls, the motion sensor's screen a sensitivity and inverted
	  axes for every game. Needs the kernel's cdc_acm.

config INPUT_SCRIPT
	bool "Scripted input from stdin"
	help
	  Words on stdin press buttons ("down a wait:500 f6"); only when
	  stdin is not a terminal.

config INPUT_SDL
	bool "SDL keyboard"
	depends on DISPLAY_SDL
	default y

endmenu

menu "System services"

config POWER
	bool "Battery and charger (sysfs power_supply)"
	default y

config POWER_UEVENT
	bool "Re-read the battery on power_supply uevents"
	depends on POWER
	default y
	help
	  Without it the battery is polled every 5 s.

config BACKLIGHT
	bool "Backlight control (sysfs)"
	default y

config AUDIO
	bool "Volume and audio output (ALSA mixer)"
	default y
	help
	  Volume, speaker or headphones (by hand or following the plug),
	  the volume keys. Talks to /dev/snd/controlC* directly: no
	  alsa-lib needed. Simulated on the PC.

config SOUND_FEEDBACK
	bool "Click when the volume changes"
	depends on AUDIO
	default y
	help
	  A short tone at the new level, played on the platform's PCM
	  device (raw ALSA ioctls). The device is released a second after
	  the click, so a game can take it.

config WIFI
	bool "Wi-Fi through wpa_supplicant"
	default y
	help
	  On/off, the networks in range, connecting with a key typed on
	  the on-screen keyboard, forgetting saved networks. Uses the
	  control socket of a running wpa_supplicant (no libwpa_client);
	  the networks are saved in its config file, which needs
	  update_config=1. Getting an address is left to the system's
	  DHCP client. Simulated on the PC.

config SYSMON
	bool "System monitor (F5 held)"
	default y
	help
	  Holding F5 for a moment shows the system monitor over any screen,
	  also over a running game, and holding it again hides it: CPU
	  load and clocks per cluster, GPU clock, memory, temperatures, the
	  battery's power, disks (I/O and free space), bare_app and the
	  game. A short press of F5 still does what it did (minimise a
	  game...), on release. Reads procfs and sysfs once a second while
	  shown.

config STREAM
	bool "Stream the screen and the sound (RTSP)"
	depends on VIEW_LVGL
	help
	  An RTSP server at rtsp://<address>:8554/live, switched on in
	  Settings > Internet: the screen as H.264 (OpenH264, BSD licence;
	  needs its library and pkg-config file) and the sound of games as
	  L16 over RTP/RTCP, UDP or interleaved in the RTSP connection. The
	  games' sound comes through the ALSA loopback (snd-aloop) and goes
	  on to the device. Open it in VLC, ffplay or mpv.

config SETTINGS_FILE
	bool "Keep settings between runs"
	default y
	help
	  Brightness, volume, audio output, Wi-Fi on/off and language in
	  the platform's settings file (/etc/bare_app.conf on the OGA).

endmenu

menu "User interface"

config VIEW_LVGL
	bool "LVGL view backend"
	default y

config VIEW_HEADLESS
	bool "Headless view backend (logs instead of drawing)"
	default y
	help
	  Also proves the core builds without a GUI toolkit.

if VIEW_LVGL

config SCREEN_INPUT_TEST
	bool "Input test screen"
	default y

config SCREEN_SETTINGS
	bool "Settings screen (brightness, sound, language, Wi-Fi status)"
	default y

config SCREEN_WIFI
	bool "Wi-Fi screens (networks, key entry)"
	depends on WIFI && SCREEN_SETTINGS
	default y
	help
	  Opened from the settings screen.

config SCREEN_USB_DISK
	bool "USB disk screen (the games partition for the computer)"
	help
	  A menu entry that shares the games partition (/games) as a USB
	  disk over the USB-C cable, to copy games from a computer. Needs
	  the platform's usb_disk command (the SDK's /usr/sbin/usb-disk);
	  without it the screen says it is not available.

config SCREEN_LAYERS
	bool "Layers screen (UI over the video layer)"
	default y
	select VIDEO_TESTPATTERN

config UI_FONT_CYRILLIC
	bool "Fonts with Cyrillic (Noto Sans)"
	default y
	help
	  Without it the built-in Montserrat fonts are used: Latin only.

endif

config LANG_RU
	bool "Russian translation"
	depends on UI_FONT_CYRILLIC || !VIEW_LVGL
	default y

config VIDEO_TESTPATTERN
	bool "Test pattern video source"
	help
	  Animated colour bars drawn by a thread into the video layer.

endmenu

menu "Games"

config GAMES
	bool
	help
	  Selected by every game: the game registry (src/games/game.h), its
	  screen and the process link (games/game_proc.c).

config GAME_DOOM
	bool "Doom (separate program under GPLv2)"
	depends on VIEW_LVGL
	select GAMES
	help
	  "Doom" in the main menu. The game is bare_app_doom, built from
	  ports/doom (doomgeneric, GPLv2) and installed next to bare_app,
	  which starts it for each game and talks to it over a socket and
	  shared memory: no GPL code goes into bare_app itself. Needs the
	  ports/doom/doomgeneric submodule. It draws into the video layer,
	  so it needs DRM on the device (pc-mem on the PC). Sound effects
	  go to the platform's ALSA device; no music, no network.

if GAME_DOOM

config GAME_DOOM_GAME
	string "Directory with IWADs"
	default "/games/doom"
	help
	  The first IWAD found here is played, in this order: doom2.wad,
	  plutonia.wad, tnt.wad, doom.wad, freedoom2.wad, freedoom1.wad,
	  doom1.wad (on FAT the case of the names does not matter). /games
	  is the SDK's FAT32 games partition, written from a PC. Empty: not
	  looked at.

config GAME_DOOM_WAD
	string "IWAD file"
	default "/usr/share/games/doom/doom1.wad"
	help
	  The game data when GAME_DOOM_GAME has none: doom1.wad
	  (shareware), doom.wad, doom2.wad... BARE_APP_DOOM_WAD overrides
	  both at run time. The SDK package installs the shareware one when
	  asked to.

config GAME_DOOM_DIR
	string "Directory for Doom's settings and saved games"
	default "~/.local/share/bare_app/doom"
	help
	  "~/" means $HOME. Created when the game starts.

endif

config GAME_HOMM3
	bool "Heroes of Might and Magic III (VCMI, separate program)"
	depends on VIEW_LVGL
	select GAMES
	help
	  "Heroes III" in the main menu: VCMI's client, built with its
	  bare_app link by the SDK package vcmi (GPLv2, APPS_CONFIG
	  bare-app.HOMM3=y), started for each game like Doom. It draws in
	  software into twice the video layer and sends it scaled down 2:1,
	  or 1:1 around the cursor (L1 switches); the gamepad drives it as
	  a game controller. The game files (Data, Maps, Mp3 of an original
	  installation, optionally the Horn of the Abyss mod) are not
	  included: see GAME_HOMM3_GAME.

if GAME_HOMM3

config GAME_HOMM3_PROGRAM
	string "VCMI client"
	default "/usr/bin/vcmiclient"

config GAME_HOMM3_GAME
	string "Game directory"
	default "/games/heroes3"
	help
	  The game files: Data, Maps and Mp3 of an original installation
	  and VCMI's mods in Mods, each in a directory named by its id
	  (hota). Every mod there is active: remove its directory to turn
	  it off. May be read-only. BARE_APP_HOMM3_GAME overrides it at run
	  time. /games is the SDK's FAT32 games partition, written from a
	  PC or by the SDK's scripts/homm3-install.sh.

config GAME_HOMM3_DATA
	string "Data directory"
	default "/data"
	help
	  VCMI keeps saved games in <dir>/vcmi/Saves, its settings in
	  <dir>/config/vcmi and its logs in <dir>/cache/vcmi; game files
	  and mods in <dir>/vcmi are found too. BARE_APP_HOMM3_DATA
	  overrides it at run time. /data is the SDK's data partition.

endif

config GAME_HALFLIFE
	bool "Half-Life (Xash3D FWGS, separate program)"
	depends on VIEW_LVGL
	select GAMES
	help
	  "Half-Life" in the main menu: the Xash3D FWGS engine (GPLv3)
	  built with its bare_app platform and the game code of
	  hlsdk-portable, from the SDK packages xash3d-fwgs and
	  hlsdk-portable (APPS_CONFIG bare-app.HALFLIFE=y), started for
	  each game like Doom. It draws into the video layer with the
	  GPU (OpenGL ES, when the engine has it) or its software
	  renderer; the gamepad is the engine's gamepad; the language is
	  bare_app's (-language). The game files are not included: see
	  GAME_HALFLIFE_GAME.

if GAME_HALFLIFE

config GAME_HALFLIFE_PREFIX
	string "Engine prefix"
	default "/usr"
	help
	  Where the engine is installed: <prefix>/bin/xash3d, its
	  libraries and the game code in <prefix>/lib/xash3d, its own
	  resources in <prefix>/share/xash3d. BARE_APP_HALFLIFE_PREFIX
	  overrides it at run time.

config GAME_HALFLIFE_GAME
	string "Game directory"
	default "/games/halflife"
	help
	  The directory that holds the valve directory of a bought copy
	  (Steam: steamapps/common/Half-Life); the Windows and macOS
	  libraries in it are not used. Read only. BARE_APP_HALFLIFE_GAME
	  overrides it at run time. /games is the SDK's FAT32 games
	  partition, written from a PC or by the SDK's
	  scripts/halflife-install.sh.

config GAME_HALFLIFE_DATA
	string "Data directory"
	default "/data/halflife"
	help
	  The engine's writable base directory: settings
	  (valve/config.cfg) and saved games (valve/SAVE). "~/" means
	  $HOME. Created when the game starts. BARE_APP_HALFLIFE_DATA
	  overrides it at run time. /data is the SDK's data partition.

endif

config GAME_NATIVE
	bool "Games described by game.ini (SDL games, separate programs)"
	depends on VIEW_LVGL
	select GAMES
	help
	  Every <dir>/*.ini and <dir>/<game>/game.ini of GAME_NATIVE_DIRS is
	  an entry of the main menu: a program of its own, started like Doom
	  with bare_app's link (games/game_ipc.h). SDL2 games need no change:
	  the SDK's SDL2 (APPS_CONFIG bare-app.SDL=y) has the video and
	  joystick drivers "bareapp", which draw the game's window into the
	  video layer (fitted to it; OpenGL ES by the GPU) and make the
	  gamepad a game controller and the keys the ini names.
	  docs/game.ini describes the file. A package installs
	  /usr/share/bare_app/games/<game>.ini; a game copied from a PC
	  brings <games>/<game>/game.ini.

if GAME_NATIVE

config GAME_NATIVE_DIRS
	string "Where the descriptions are"
	default "/usr/share/bare_app/games /games"
	help
	  Directories separated by spaces. BARE_APP_NATIVE_DIRS overrides
	  them at run time.

config GAME_NATIVE_DATA
	string "Data directory"
	default "/data"
	help
	  Each game gets <dir>/<game> as its HOME (settings, saved games)
	  and working directory, made when it starts. "~/" means $HOME.
	  BARE_APP_NATIVE_DATA overrides it at run time.

endif

config GAME_WINE
	bool "Windows games (Wine, separate program)"
	depends on VIEW_LVGL
	select GAMES
	help
	  Every <games>/<game>/wine.ini is an entry of the main menu: a
	  Windows game run by Wine with the SDK's winebare.drv driver
	  (packages wine-wow64 and wowbox64: 32-bit x86 games on arm64,
	  APPS_CONFIG bare-app.WINE=y). bare_app_wine, built from
	  ports/wine and installed next to bare_app, starts Wine for each
	  game, composes its windows into the video layer and turns the
	  gamepad into mouse and keyboard after the [keys] of wine.ini
	  (ports/wine/wine.ini describes the file).

if GAME_WINE

config GAME_WINE_GAMES
	string "Games directory"
	default "/games"
	help
	  Each subdirectory with a wine.ini is a game; it is drive D: of
	  Wine. BARE_APP_WINE_GAMES overrides it at run time.

config GAME_WINE_PREFIX
	string "Wine prefix"
	default "/data/wine/prefix"
	help
	  One prefix shared by the games: Wine's registry and drive C:
	  with the saved games of those that keep them in the user's
	  documents. Made by wineboot on the first start (about a
	  minute). BARE_APP_WINE_PREFIX overrides it at run time.

config GAME_WINE_BIN
	string "Directory of Wine's programs"
	default "/usr/bin"
	help
	  Where wine and wineserver are. BARE_APP_WINE_BIN overrides it
	  at run time.

endif

endmenu

menu "Debugging"

config SNAPSHOT
	bool "Screenshots (SIGUSR1, BARE_APP_SHOT)"
	default y
	help
	  Write the composed layers as a PPM image on SIGUSR1, and on exit
	  if BARE_APP_SHOT is set.

config BUILD_TESTS
	bool "Host unit tests and the smoke test"
	depends on PLATFORM_PC && VIEW_HEADLESS
	default y
	help
	  Built only for the host (not when cross-compiling).

endmenu
```
